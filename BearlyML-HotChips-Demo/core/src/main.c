/* USER CODE BEGIN Header */
/**
 ******************************************************************************
 * @file           : main.c
 * @brief          : Main program body
 ******************************************************************************
 * @attention
 *
 * This software is licensed under terms that can be found in the LICENSE file
 * in the root directory of this software component.
 * If no LICENSE file comes with this software, it is provided AS-IS.
 *
 ******************************************************************************
 */
/* USER CODE END Header */
/* Includes ------------------------------------------------------------------*/
#include "main.h"

/* Private includes ----------------------------------------------------------*/
/* USER CODE BEGIN Includes */

/* USER CODE END Includes */

/* Private typedef -----------------------------------------------------------*/
/* USER CODE BEGIN PTD */

/* USER CODE END PTD */

/* Private define ------------------------------------------------------------*/
/* USER CODE BEGIN PD */
/* USER CODE END PD */

/* Private macro -------------------------------------------------------------*/
/* USER CODE BEGIN PM */

#define STR1(x) #x
#ifndef STR
#define STR(x) STR1(x)
#endif

#define CAT_(A, B) A##B
#define CAT(A, B) CAT_(A, B)

#define ROCC_INSTRUCTION_R_R_R(x, rd, rs1, rs2, func7)                   \
  {                                                                      \
    asm volatile(".insn r " STR(CAT(CUSTOM_, x)) ", " STR(0x7) ", " STR( \
                     func7) ", %0, %1, %2"                               \
                 : "=r"(rd)                                              \
                 : "r"(rs1), "r"(rs2));                                  \
  }

#define ROCC_INSTRUCTION_0_R_R(x, rs1, rs2, func7)                       \
  {                                                                      \
    asm volatile(".insn r " STR(CAT(CUSTOM_, x)) ", " STR(0x3) ", " STR( \
                     func7) ", x0, %0, %1"                               \
                 :                                                       \
                 : "r"(rs1), "r"(rs2));                                  \
  }

/* USER CODE END PM */

/* Private variables ---------------------------------------------------------*/

/* USER CODE BEGIN PV */

/* USER CODE END PV */

/* Private function prototypes -----------------------------------------------*/

/* USER CODE BEGIN PFP */

/* USER CODE END PFP */

/* Private user code ---------------------------------------------------------*/
/* USER CODE BEGIN 0 */

const uint8_t L1_w_p_ptr[32] __attribute__((aligned(8))) = {
    56, 56, 44, 60, 20, 60, 60, 24, 72, 60, 56, 60, 52, 48, 40, 48,
    52, 56, 48, 40, 48, 56, 20, 40, 64, 52, 72, 44, 28, 36, 44, 52};
const uint8_t L1_w_n_ptr[32] __attribute__((aligned(8))) = {
    28, 28, 40, 40, 32, 44, 44, 52, 44, 36, 40, 40, 28, 28, 36, 40,
    28, 32, 40, 20, 40, 48, 28, 44, 32, 56, 36, 28, 32, 56, 24, 44};
const uint8_t L1_w_p_arr[3136] __attribute__((aligned(8))) = {
    1, 17,  1, 32,  1, 35,  1, 36,  1, 37,  1, 39,  1, 41,  1, 52,  1, 60,
    1, 67,  1, 68,  1, 70,  2, 74,  2, 75,  2, 76,  1, 81,  1, 82,  1, 85,
    2, 89,  3, 90,  1, 95,  1, 103, 2, 104, 1, 106, 1, 108, 1, 109, 1, 111,
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    0, 195, 0, 195};
const uint8_t L1_w_n_arr[2376] __attribute__((aligned(8))) = {
    1, 5,   1, 20,  1, 40,  1, 49,  1, 57,  3, 63,  3, 64,  1, 65,  1, 69,
    2, 77,  1, 78,  1, 84,  1, 86,  1, 100, 1, 102, 1, 107, 1, 123, 1, 128,
    1, 142, 1, 151, 1, 157, 1, 178, 1, 179, 1, 188, 1, 193, 0, 195, 0, 195,
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    1, 149, 1, 150, 1, 151, 1, 152, 1, 165, 1, 167, 1, 188, 1, 189, 1, 190};
const uint8_t L2_w_p_ptr[10]
    __attribute__((aligned(8))) = {16, 12, 16, 8, 16, 8, 12, 16, 16, 16};
const uint8_t L2_w_n_ptr[10]
    __attribute__((aligned(8))) = {12, 20, 12, 16, 16, 12, 16, 16, 12, 12};
const uint8_t L2_w_p_arr[272] __attribute__((aligned(8))) = {
    2, 1,  5, 2,  5, 8,  1, 11, 1, 12, 1, 13, 1, 15, 3, 16, 2, 17, 1, 19, 1, 25,
    2, 27, 1, 31, 0, 31, 0, 31, 0, 31, 1, 2,  4, 5,  5, 7,  1, 11, 1, 13, 1, 18,
    1, 19, 1, 23, 6, 29, 1, 31, 0, 31, 0, 31, 1, 4,  4, 5,  2, 8,  2, 11, 1, 12,
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    3, 31, 0, 31, 0, 31, 0, 31};
const uint8_t L2_w_n_arr[288] __attribute__((aligned(8))) = {
    1, 0,  3, 3,  2, 5,  2, 6,  1, 7,  4, 9,  2, 18, 1, 23, 2, 24, 1, 26, 3, 29,
    0, 31, 2, 0,  2, 1,  1, 3,  1, 8,  3, 10, 1, 12, 1, 14, 2, 15, 1, 16, 3, 17,
    1, 20, 1, 21, 2, 24, 3, 25, 1, 26, 1, 27, 3, 30, 0, 31, 0, 31, 0, 31, 1, 0,
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    0, 31};

const float L1_b[32] __attribute__((aligned(8))) = {
    -0.21996102, 0.02680125,  0.06465499,  0.40749273, -0.02139925, 0.06114511,
    0.17844151,  0.33464688,  0.26875934,  0.1545577,  0.26635364,  -0.0693506,
    0.01508743,  -0.11577939, 0.11993501,  0.16154365, -0.09921514, 0.18440361,
    0.11081247,  0.08887127,  0.16604227,  0.26086533, 0.02794394,  0.3033326,
    0.07179166,  0.23188311,  -0.11208464, 0.37733203, 0.17358075,  0.53600323,
    0.00633177,  0.20400575};
const float L2_b[10] __attribute__((aligned(8))) = {
    -0.24144834, 0.3960018,   0.03745702, 0.04361735,  0.17572264,
    -0.09629191, -0.02782477, 0.14699028, -0.44779482, 0.01357366};

const uint8_t L1_x_size = 196;
const uint8_t L2_x_size = 32;
const uint8_t out_size = 10;
const uint8_t batch_size = 8;

const float L1_s_x = 0.22135417;
const float L1_s_w = 0.16020206;
const float L2_s_x = 0.9230769;
const float L2_s_w = 0.25272506;

const uint8_t x[1568] __attribute__((aligned(8))) = {
    0, 0, 0, 0, 0, 0, 0, 0, 0, 0, 0, 0, 0, 0, 0, 0, 0, 0, 0, 0, 0, 0, 0, 0, 0,
    0, 0, 0, 0, 0, 0, 0, 0, 0, 0, 0, 0, 0, 0, 0, 0, 0, 0, 0, 0, 0, 0, 0, 0, 0,
    0, 0, 0, 0, 0, 0, 0, 0, 0, 0, 0, 0, 0, 0, 0, 0, 0, 0, 0, 0, 0, 0, 0, 0, 0,
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    0, 0, 0, 0, 0, 0, 0, 0, 0, 0, 0, 0, 0, 0, 0, 0, 0, 0};

const uint8_t y[8] = {3, 8, 6, 9, 6, 3, 8, 2};

const uint32_t dense_matrix_stride = 8;

uint8_t h1_buf_pos[2 * 32 * 8] __attribute__((aligned(8)));
uint8_t h1_buf_neg[2 * 32 * 8] __attribute__((aligned(8)));
uint8_t out_buf_pos[2 * 10 * 8] __attribute__((aligned(8)));
uint8_t out_buf_neg[2 * 10 * 8] __attribute__((aligned(8)));

// Various monkey printing functions because printf is crippled...

void print_array(uint8_t *arr, size_t size) {
  char str[64];
  size_t i = 0;
  while (i < size) {
    sprintf(str, "%d", *(arr + i));
    HAL_UART_transmit(UART0, (uint8_t *)str, strlen(str), 100);

    i += 1;
    if (i < size) {
      sprintf(str, ", ");
      HAL_UART_transmit(UART0, (uint8_t *)str, strlen(str), 100);
    }
    if ((i % 16) == 0) {
      HAL_UART_transmit(UART0, (uint8_t *)"\n", 1, 100);
    }
  }
  HAL_UART_transmit(UART0, (uint8_t *)"\n", 1, 100);
}

uint8_t print_compare_array(uint8_t *a, uint8_t *b, size_t size) {
  uint8_t incorrect = 0;
  size_t i = 0;
  while (i < size) {
    if (*(a + i) != *(b + i)) {
      HAL_UART_transmit(UART0, (uint8_t *)"X", 1, 100);
      incorrect = 1;
    }
    else
      HAL_UART_transmit(UART0, (uint8_t *)"O", 1, 100);
  }
  HAL_UART_transmit(UART0, (uint8_t *)"\n", 1, 100);
  return incorrect;
}

void print_mnist() {
  char str[64];
  for (size_t i = 0; i < batch_size; i++) {
    sprintf(str, "%d: \n", y[i]);
    HAL_UART_transmit(UART0, (uint8_t *)str, strlen(str), 100);
    
    for (int j = 0; j < L1_x_size; j++) {
      uint8_t curr = *(x + i + j * batch_size);
      if (curr == 0)
        HAL_UART_transmit(UART0, (uint8_t *)"  ", 2, 100);
      else if (curr == 1)
        HAL_UART_transmit(UART0, (uint8_t *)"--", 2, 100);
      else if (curr == 2)
        HAL_UART_transmit(UART0, (uint8_t *)"++", 2, 100);
      else if (curr == 3)
        HAL_UART_transmit(UART0, (uint8_t *)"##", 2, 100);
      else if (curr >= 4)
        HAL_UART_transmit(UART0, (uint8_t *)"@@", 2, 100);
      
      if (j % 14 == 0) {
        HAL_UART_transmit(UART0, (uint8_t *)"\n", 1, 100);
      }
    }
    HAL_UART_transmit(UART0, (uint8_t *)"\n", 1, 100);
  }
  HAL_UART_transmit(UART0, (uint8_t *)"\n", 1, 100);
}

// [10x8]=[10x32][32x196][196x8]
uint8_t uint_matmul(const uint8_t *w_ptr, const uint8_t *w_arr,
                const uint8_t *x_arr, uint8_t *output,
                size_t w_ptr_size, size_t batch_size) {
  // Assume batch size of 8
  size_t dense_matrix_size = batch_size / dense_matrix_stride;
  /*
  printf("dense_matrix_size:");
  print_char((unsigned char)dense_matrix_size);
  printf("\n");
  */

  // int sparse_row_size = 4;// WARNING SKIP THE ZEROS IT MIGHT CAUSE HELLACACHE
  // ERROR

  uint8_t *internal_w_arr = (uint8_t *)w_arr;
  uint32_t casted_w_ptr;
  uint8_t *output_ptr = output;

  for (size_t i=0; i<w_ptr_size; i+=1) {
    /*
    printf("int i = ");
    print_int(i);
    printf("; i < ");
    print_int(w_ptr_size);
    printf("; w_ptr[i] = ");
    print_int((int)(w_ptr[i]));
    printf("\n");
    */
    /* EXPLICITLY MASK THE REGISTER SO THAT IT ONLY HAS INT8 ELEMENTS MAX
        DO NOT USE (int)w_ptr[i] IT READS THE REST OF THE ELEMENTS IN PACKED
       ARRAY AND SENDS ALL 64 BITS OVER, IT WILL OVERFLOW QUICKLY
    */
    casted_w_ptr = (uint8_t)w_ptr[i];

    asm volatile("fence");
    ROCC_INSTRUCTION_0_R_R(0, internal_w_arr, casted_w_ptr, 0);
    ROCC_INSTRUCTION_0_R_R(0, x_arr, dense_matrix_size, 1);
    ROCC_INSTRUCTION_0_R_R(0, output_ptr, output_ptr, 2);
    asm volatile("fence");
    // Parallely compute on CPU to check results
    /*
    for (int k = 0; k < batch_size; k++) {
      unsigned char result = 0;
      for (int j = 0; j < w_ptr[i]; j++) {
        result += internal_w_arr[j*2] * (*(x_arr + internal_w_arr[1 +
    j*2]*batch_size + k));

        print_int(result);
        printf("=");
        print_int(internal_w_arr[j*2]);
        printf(" * ");
        print_int((*(x_arr + internal_w_arr[1 + j*2]*batch_size + k)));
        printf("\n");

      }
      //printf("batch finished \n");
      *(output + w_ptr_size*batch_size + i*batch_size + k) = result;
    }
    */

    internal_w_arr = internal_w_arr + (w_ptr[i] * 2);
    output_ptr = output_ptr + batch_size;
  }
  /*
  printf("\nw_ptr[0]=");
  print_char(w_ptr[0]);
  printf("\nw_arr[0]=");
  print_char(w_arr[0]);
  printf("\nx_arr[0]=");
  print_char(x_arr[0]);
  printf("\nx_arr[1]=");
  print_char(x_arr[1]);
  printf("\n");
  */

  char str[64];
  sprintf(str, "Accelerator result:\n");
  HAL_UART_transmit(UART0, (uint8_t *)str, strlen(str), 100);
  asm volatile("fence");
  print_array(output, w_ptr_size * batch_size);
  /*
  printf("CPU result:\n");
  print_array(output + w_ptr_size*batch_size, w_ptr_size*batch_size);
  printf("Compare bits:\n");
  print_compare_array(output, output+w_ptr_size*batch_size,
  w_ptr_size*batch_size);
  */

  return 0;
}

/*  https://stackoverflow.com/questions/70382318/ex-without-math-h?noredirect=1&lq=1
    e^x
    Actually for inference we don't care about relative probability, just the
max. double fabs1(double x) { if(x >= 0){ return x; } else { return x*(-1);
    }
}

double powerex(double x) {
    double a = 1.0, e = 0;
    int invert = x<0;
    x = fabs1(x);
    for (int n = 1; e != e + a ; ++n) {
        e += a;
        a = a * x / n;
    }
    return invert ? 1/e : e;
}
*/

uint8_t round_float(float n) {
  return (uint8_t)((n > 0) ? (n + 0.5) : (n - 0.5));
}

/*
Quantize and scales every thing properly going into the second layer.
Writes the back to the positive buffer.
Either activates with relu6 or directly searches maximum of float output.
*/
void float_covfefe(uint8_t *pos, uint8_t *neg, const float *bias,
                  size_t size, const float pre_scale, const float post_scale,
                  size_t activate) {
  char str[128];

  for (size_t j = 0; j < 8; j++) {
    float max = 1.175494351e-38;
    uint8_t max_idx = 0;
    for (size_t i = 0; i < size; i++) {
      float curr = ((float)(((int32_t)((uint8_t)*(pos + i * 8 + j))) -
                            ((int32_t)((uint8_t)*(neg + i * 8 + j)))));
      curr = (curr * pre_scale) + bias[i];
      if (activate == 1 && curr < 0.0) curr = 0.0;
      if (activate == 1 && curr > 6.0) curr = 6.0;
      // +0.5 so it rounds properly, c by default just truncates
      if (activate == 0) {
        sprintf(str, "%f, ", curr);
        HAL_UART_transmit(UART0, (uint8_t *)str, strlen(str), 100);

        *(pos + i * 8 + j) = 0;
        if (max < curr) {
          max = curr;
          max_idx = (uint8_t)i;
        }
      }
      else {
        *(pos + i * 8 + j) = round_float(curr / post_scale);
      }
    }
    if (activate == 0) {
      // printf("pointer = ");
      // print_pointer(pos+j);
      // printf("\n");
      //*(pos+j) = y[j];
      *(pos + j) = max_idx;
      sprintf(str, "max_idx = %d\n", max_idx);
      HAL_UART_transmit(UART0, (uint8_t *)str, strlen(str), 100);
    }
  }
}

/* List of const variables
uint8_t L1_w_p_ptr[196]
uint8_t L1_w_n_ptr[196]
uint8_t L1_w_p_arr[2928]
uint8_t L1_w_n_arr[2424]
uint8_t L2_w_p_ptr[32]
uint8_t L2_w_n_ptr[32]
uint8_t L2_w_p_arr[320]
uint8_t L2_w_n_arr[312]
float L1_b[32]
float L2_b[10]
uint8_t L1_x_size
uint8_t L2_x_size
uint8_t out_size
uint8_t batch_size
float L1_s_x
float L1_s_w
float L2_s_x
float L2_s_w
uint8_t x[1960]
uint8_t y[8]

Normal variables
uint8_t h1_buf_pos[2][32][8] __attribute__ ((aligned (64)));
uint8_t h1_buf_neg[2][32][8] __attribute__ ((aligned (64)));
uint8_t out_buf_pos[2][10][8] __attribute__ ((aligned (64)));
uint8_t out_buf_neg[2][10][8] __attribute__ ((aligned (64)));


int uint_matmul(const uint8_t* w_ptr, const uint8_t* w_arr, const
uint8_t* x_arr, uint8_t* output, int w_ptr_size, int batch_size)
*/
/* USER CODE END 0 */

/**
 * @brief  The application entry point.
 * @retval int
 */
int main(void) {
  /* USER CODE BEGIN 1 */

  /* USER CODE END 1 */

  /* MCU Configuration--------------------------------------------------------*/

  /* USER CODE BEGIN Init */

  /* USER CODE END Init */

  /* Configure the system clock */
  HAL_RCC_InitSystemClock();

  /* USER CODE BEGIN SysInit */

  /* USER CODE END SysInit */

  /* Initialize all configured peripherals */
  UART_InitTypeDef UART_init_config;
  UART_init_config.baudrate = 115200;
  UART_init_config.mode = UART_MODE_TX_RX;
  UART_init_config.stopbits = UART_STOPBITS_1;
  HAL_UART_init(UART0, &UART_init_config);

  /* USER CODE BEGIN 2 */

  /* USER CODE END 2 */

  /* Infinite loop */
  /* USER CODE BEGIN WHILE */

  while (1) {
    char str[128];

    sprintf(str, "MNIST Data Check:\n");
    HAL_UART_transmit(UART0, (uint8_t *)str, strlen(str), 100);

    print_mnist();
    uint64_t begin_time = CLINT->MTIME;

    sprintf(str, "L1 Matmul Positive...\n");
    HAL_UART_transmit(UART0, (uint8_t *)str, strlen(str), 100);

    uint_matmul(L1_w_p_ptr, L1_w_p_arr, x, h1_buf_pos, L2_x_size, batch_size);

    sprintf(str, "L1 Matmul Negative...\n");
    HAL_UART_transmit(UART0, (uint8_t *)str, strlen(str), 100);

    uint_matmul(L1_w_n_ptr, L1_w_n_arr, x, h1_buf_neg, L2_x_size, batch_size);

    sprintf(str, "rescaling and requantizing...\n");
    HAL_UART_transmit(UART0, (uint8_t *)str, strlen(str), 100);

    float_covfefe(h1_buf_pos, h1_buf_neg, L1_b, L2_x_size, L1_s_x * L1_s_w, L2_s_x, 1);

    sprintf(str, "Array:\n");
    HAL_UART_transmit(UART0, (uint8_t *)str, strlen(str), 100);

    print_array(h1_buf_pos, (uint32_t)L2_x_size * (uint32_t)batch_size);

    sprintf(str, "L2 Matmul Positive...\n");
    HAL_UART_transmit(UART0, (uint8_t *)str, strlen(str), 100);

    uint_matmul(L2_w_p_ptr, L2_w_p_arr, h1_buf_pos, out_buf_pos, out_size, batch_size);

    sprintf(str, "L2 Matmul Negaitve...\n");
    HAL_UART_transmit(UART0, (uint8_t *)str, strlen(str), 100);

    uint_matmul(L2_w_n_ptr, L2_w_n_arr, h1_buf_pos, out_buf_neg, out_size, batch_size);

    sprintf(str, "rescaling and finding max...\n");
    HAL_UART_transmit(UART0, (uint8_t *)str, strlen(str), 100);

    float_covfefe(out_buf_pos, out_buf_neg, L2_b, out_size, L2_s_x * L2_s_w, 0.0, 0);
    uint64_t cycles_taken = CLINT->MTIME - begin_time;

    sprintf(str, "Cycles taken = %lu\n", cycles_taken);
    HAL_UART_transmit(UART0, (uint8_t *)str, strlen(str), 100);

    int32_t correct_count = 0;

    sprintf(str, "Checking predictions...\n");
    HAL_UART_transmit(UART0, (uint8_t *)str, strlen(str), 100);

    for (size_t i=0; i<8; i+=1) {
      sprintf(str, "label=%d; pred=%d\n", y[i], *(out_buf_pos + i));
      HAL_UART_transmit(UART0, (uint8_t *)str, strlen(str), 100);

      // printf("; pointer=");
      // print_pointer(out_buf_pos + i);

      correct_count += (y[i] == *(out_buf_pos + i)) ? 1 : 0;
    }

    sprintf(str, "Correct count: %d\n", correct_count);
    HAL_UART_transmit(UART0, (uint8_t *)str, strlen(str), 100);

    if (correct_count == 8) {
      sprintf(str, "Test passed!\n");
      HAL_UART_transmit(UART0, (uint8_t *)str, strlen(str), 100);
      // return 0;
    }
    else {
      sprintf(str, "Test failed!\n");
      HAL_UART_transmit(UART0, (uint8_t *)str, strlen(str), 100);
      // return 1;
    }

    HAL_delay(1000);
    /* USER CODE END WHILE */
  }

  /* USER CODE BEGIN 3 */

  /* USER CODE END 3 */
}

// int _write(int handle, char *data, int size) {
//   int count;
//   char str[128];
//   sprintf(str, "hello\n");
//   HAL_UART_transmit(UART0, (uint8_t *)str, strlen(str), 1000);
//   handle = handle;  // unused
//   // for( count = 0; count < size; count++) {
//   //     // outputByte( data[count] ) ;  // Your low-level output function here.
//   // }
//   return size;
// }
